## boards/shields/keebo/Kconfig.defconfig
```kconfig
if SHIELD_KEEBO

# Name must be less than 16 characters long!
config ZMK_KEYBOARD_NAME
    default "Keebo"

endif
```

## boards/shields/keypad/Kconfig.defconfig
```kconfig
if SHIELD_KEYPAD

config ZMK_KEYBOARD_NAME
    default "Keypad"

config SPI
    default y

endif # SHIELD_KEYPAD
```

## boards/shields/test/Kconfig.defconfig
```kconfig
if SHIELD_TEST

config ZMK_KEYBOARD_NAME
    default "test"

endif # SHIELD_TEST
```

## module/kscan-custom/Kconfig
```kconfig
menuconfig KSCAN_CUSTOM
    bool "Custom kscan driver"

if KSCAN_CUSTOM
module = KSCAN_CUSTOM
module-str = KSCAN_CUSTOM
source "${ZEPHYR_BASE}/subsys/logging/Kconfig.template.log_config"

endif #PMW3610
```

## module/kscan_custom/dts/bindings/zmk,kscan-gpio-custom.yaml
```yaml
# Copyright (c) 2020, The ZMK Contributors
# SPDX-License-Identifier: MIT

description: GPIO keyboard custom controller

compatible: "zmk,kscan-gpio-custom"

include: kscan.yaml

properties:
  in-addr-gpios:
    type: phandle-array
    required: true
  in-data-gpios:
    type: phandle-array
    required: true
  output-gpios:
    type: phandle-array
    required: true
  debounce-period:
    type: int
    default: 5
  cols:
    type: int
    required: true
  polling-interval-msec:
    type: int
    default: 25
```
