/*
 * Copyright (c) 2019 Peter Bigot Consulting, LLC
 *
 * SPDX-License-Identifier: Apache-2.0
 */

/ {
	msc_disk0 {
		compatible = "zephyr,flash-disk";
		partition = <&external_partition>;
		disk-name = "NAND";
		cache-size = <4096>;
	};
};
